## conf/layer.conf
```bitbake
BBPATH .= ":${LAYERDIR}"

BBFILES += "${LAYERDIR}/recipes-*/*/*.bb \
            ${LAYERDIR}/recipes-*/*/*.bbappend"

BBFILE_COLLECTIONS += "vigilo"
BBFILE_PATTERN_vigilo = "^${LAYERDIR}/"
BBFILE_PRIORITY_vigilo = "6"

LAYERDEPENDS_vigilo = "core"
LAYERSERIES_COMPAT_vigilo = "scarthgap"
```
